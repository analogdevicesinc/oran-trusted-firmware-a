// SPDX-License-Identifier: BSD-3-Clause
/*
 * Copyright (c) 2023, Analog Devices Incorporated, All Rights Reserved
 */

/dts-v1/;

#include "titan-fw-config.dtsi"

/ {
	dual-tile;

#ifdef SECONDARY_LINUX_ENABLED
	/* Enables Linux on the secondary tile */
	secondary-linux-enabled;
#endif
};
